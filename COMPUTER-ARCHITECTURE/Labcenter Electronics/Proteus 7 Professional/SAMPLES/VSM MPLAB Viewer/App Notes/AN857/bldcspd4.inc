; file : BLDCSpd4.inc
;
; NOTE: This file is built using the Excel 
;       "BLDC Table Generator" Spreadsheet
;       Enter the motor specifics in the spreadsheet
;       then cut the resulting MS Byte code and LS Byte code 
;       from the spreadsheet and paste to the respective tables.
;
; BLDC speed lookup table
; MaxRPM = 8000
; MinRPM = 96
; Phases per mechanical revolution = 12
; Fosc = 20 MHz
; Timer 1 prescale = 4
; 0 RPM Axis intercept = -345 RPM
;

T1HighTable        ; MS Byte code
	retlw high D'64854'
	retlw high D'64854'
	retlw high D'64854'
	retlw high D'64854'
	retlw high D'64854'
	retlw high D'64854'
	retlw high D'64854'
	retlw high D'64854'
	retlw high D'64854'
	retlw high D'64854'
	retlw high D'64854'
	retlw high D'64854'
	retlw high D'64854'
	retlw high D'64854'
	retlw high D'64854'
	retlw high D'64854'
	retlw high D'49189'
	retlw high D'39062'
	retlw high D'32393'
	retlw high D'27669'
	retlw high D'24147'
	retlw high D'21421'
	retlw high D'19248'
	retlw high D'17475'
	retlw high D'16001'
	retlw high D'14756'
	retlw high D'13692'
	retlw high D'12770'
	retlw high D'11965'
	retlw high D'11255'
	retlw high D'10625'
	retlw high D'10061'
	retlw high D'9554'
	retlw high D'9096'
	retlw high D'8680'
	retlw high D'8300'
	retlw high D'7952'
	retlw high D'7632'
	retlw high D'7337'
	retlw high D'7064'
	retlw high D'6810'
	retlw high D'6574'
	retlw high D'6354'
	retlw high D'6148'
	retlw high D'5955'
	retlw high D'5774'
	retlw high D'5603'
	retlw high D'5443'
	retlw high D'5291'
	retlw high D'5147'
	retlw high D'5011'
	retlw high D'4882'
	retlw high D'4760'
	retlw high D'4643'
	retlw high D'4532'
	retlw high D'4427'
	retlw high D'4326'
	retlw high D'4229'
	retlw high D'4137'
	retlw high D'4049'
	retlw high D'3964'
	retlw high D'3883'
	retlw high D'3805'
	retlw high D'3730'
	retlw high D'3658'
	retlw high D'3589'
	retlw high D'3522'
	retlw high D'3458'
	retlw high D'3396'
	retlw high D'3336'
	retlw high D'3279'
	retlw high D'3223'
	retlw high D'3169'
	retlw high D'3117'
	retlw high D'3067'
	retlw high D'3018'
	retlw high D'2971'
	retlw high D'2925'
	retlw high D'2880'
	retlw high D'2837'
	retlw high D'2796'
	retlw high D'2755'
	retlw high D'2716'
	retlw high D'2677'
	retlw high D'2640'
	retlw high D'2604'
	retlw high D'2568'
	retlw high D'2534'
	retlw high D'2501'
	retlw high D'2468'
	retlw high D'2436'
	retlw high D'2406'
	retlw high D'2375'
	retlw high D'2346'
	retlw high D'2317'
	retlw high D'2289'
	retlw high D'2262'
	retlw high D'2235'
	retlw high D'2209'
	retlw high D'2184'
	retlw high D'2159'
	retlw high D'2135'
	retlw high D'2111'
	retlw high D'2088'
	retlw high D'2065'
	retlw high D'2043'
	retlw high D'2021'
	retlw high D'2000'
	retlw high D'1979'
	retlw high D'1958'
	retlw high D'1938'
	retlw high D'1919'
	retlw high D'1900'
	retlw high D'1881'
	retlw high D'1862'
	retlw high D'1844'
	retlw high D'1826'
	retlw high D'1809'
	retlw high D'1792'
	retlw high D'1775'
	retlw high D'1759'
	retlw high D'1742'
	retlw high D'1727'
	retlw high D'1711'
	retlw high D'1696'
	retlw high D'1681'
	retlw high D'1666'
	retlw high D'1651'
	retlw high D'1637'
	retlw high D'1623'
	retlw high D'1609'
	retlw high D'1596'
	retlw high D'1582'
	retlw high D'1569'
	retlw high D'1557'
	retlw high D'1544'
	retlw high D'1531'
	retlw high D'1519'
	retlw high D'1507'
	retlw high D'1495'
	retlw high D'1483'
	retlw high D'1472'
	retlw high D'1461'
	retlw high D'1449'
	retlw high D'1438'
	retlw high D'1428'
	retlw high D'1417'
	retlw high D'1406'
	retlw high D'1396'
	retlw high D'1386'
	retlw high D'1376'
	retlw high D'1366'
	retlw high D'1356'
	retlw high D'1346'
	retlw high D'1337'
	retlw high D'1328'
	retlw high D'1318'
	retlw high D'1309'
	retlw high D'1300'
	retlw high D'1291'
	retlw high D'1283'
	retlw high D'1274'
	retlw high D'1266'
	retlw high D'1257'
	retlw high D'1249'
	retlw high D'1241'
	retlw high D'1233'
	retlw high D'1225'
	retlw high D'1217'
	retlw high D'1209'
	retlw high D'1201'
	retlw high D'1194'
	retlw high D'1186'
	retlw high D'1179'
	retlw high D'1172'
	retlw high D'1165'
	retlw high D'1157'
	retlw high D'1150'
	retlw high D'1143'
	retlw high D'1137'
	retlw high D'1130'
	retlw high D'1123'
	retlw high D'1117'
	retlw high D'1110'
	retlw high D'1104'
	retlw high D'1097'
	retlw high D'1091'
	retlw high D'1085'
	retlw high D'1078'
	retlw high D'1072'
	retlw high D'1066'
	retlw high D'1060'
	retlw high D'1054'
	retlw high D'1049'
	retlw high D'1043'
	retlw high D'1037'
	retlw high D'1031'
	retlw high D'1026'
	retlw high D'1020'
	retlw high D'1015'
	retlw high D'1009'
	retlw high D'1004'
	retlw high D'999'
	retlw high D'994'
	retlw high D'988'
	retlw high D'983'
	retlw high D'978'
	retlw high D'973'
	retlw high D'968'
	retlw high D'963'
	retlw high D'958'
	retlw high D'954'
	retlw high D'949'
	retlw high D'944'
	retlw high D'939'
	retlw high D'935'
	retlw high D'930'
	retlw high D'926'
	retlw high D'921'
	retlw high D'917'
	retlw high D'912'
	retlw high D'908'
	retlw high D'904'
	retlw high D'899'
	retlw high D'895'
	retlw high D'891'
	retlw high D'887'
	retlw high D'883'
	retlw high D'878'
	retlw high D'874'
	retlw high D'870'
	retlw high D'866'
	retlw high D'862'
	retlw high D'859'
	retlw high D'855'
	retlw high D'851'
	retlw high D'847'
	retlw high D'843'
	retlw high D'840'
	retlw high D'836'
	retlw high D'832'
	retlw high D'829'
	retlw high D'825'
	retlw high D'821'
	retlw high D'818'
	retlw high D'814'
	retlw high D'811'
	retlw high D'807'
	retlw high D'804'
	retlw high D'801'
	retlw high D'797'
	retlw high D'794'
	retlw high D'791'
	retlw high D'787'
	retlw high D'784'
	retlw high D'781'

T1LowTable		; LS Byte code
	retlw low D'64854'
	retlw low D'64854'
	retlw low D'64854'
	retlw low D'64854'
	retlw low D'64854'
	retlw low D'64854'
	retlw low D'64854'
	retlw low D'64854'
	retlw low D'64854'
	retlw low D'64854'
	retlw low D'64854'
	retlw low D'64854'
	retlw low D'64854'
	retlw low D'64854'
	retlw low D'64854'
	retlw low D'64854'
	retlw low D'49189'
	retlw low D'39062'
	retlw low D'32393'
	retlw low D'27669'
	retlw low D'24147'
	retlw low D'21421'
	retlw low D'19248'
	retlw low D'17475'
	retlw low D'16001'
	retlw low D'14756'
	retlw low D'13692'
	retlw low D'12770'
	retlw low D'11965'
	retlw low D'11255'
	retlw low D'10625'
	retlw low D'10061'
	retlw low D'9554'
	retlw low D'9096'
	retlw low D'8680'
	retlw low D'8300'
	retlw low D'7952'
	retlw low D'7632'
	retlw low D'7337'
	retlw low D'7064'
	retlw low D'6810'
	retlw low D'6574'
	retlw low D'6354'
	retlw low D'6148'
	retlw low D'5955'
	retlw low D'5774'
	retlw low D'5603'
	retlw low D'5443'
	retlw low D'5291'
	retlw low D'5147'
	retlw low D'5011'
	retlw low D'4882'
	retlw low D'4760'
	retlw low D'4643'
	retlw low D'4532'
	retlw low D'4427'
	retlw low D'4326'
	retlw low D'4229'
	retlw low D'4137'
	retlw low D'4049'
	retlw low D'3964'
	retlw low D'3883'
	retlw low D'3805'
	retlw low D'3730'
	retlw low D'3658'
	retlw low D'3589'
	retlw low D'3522'
	retlw low D'3458'
	retlw low D'3396'
	retlw low D'3336'
	retlw low D'3279'
	retlw low D'3223'
	retlw low D'3169'
	retlw low D'3117'
	retlw low D'3067'
	retlw low D'3018'
	retlw low D'2971'
	retlw low D'2925'
	retlw low D'2880'
	retlw low D'2837'
	retlw low D'2796'
	retlw low D'2755'
	retlw low D'2716'
	retlw low D'2677'
	retlw low D'2640'
	retlw low D'2604'
	retlw low D'2568'
	retlw low D'2534'
	retlw low D'2501'
	retlw low D'2468'
	retlw low D'2436'
	retlw low D'2406'
	retlw low D'2375'
	retlw low D'2346'
	retlw low D'2317'
	retlw low D'2289'
	retlw low D'2262'
	retlw low D'2235'
	retlw low D'2209'
	retlw low D'2184'
	retlw low D'2159'
	retlw low D'2135'
	retlw low D'2111'
	retlw low D'2088'
	retlw low D'2065'
	retlw low D'2043'
	retlw low D'2021'
	retlw low D'2000'
	retlw low D'1979'
	retlw low D'1958'
	retlw low D'1938'
	retlw low D'1919'
	retlw low D'1900'
	retlw low D'1881'
	retlw low D'1862'
	retlw low D'1844'
	retlw low D'1826'
	retlw low D'1809'
	retlw low D'1792'
	retlw low D'1775'
	retlw low D'1759'
	retlw low D'1742'
	retlw low D'1727'
	retlw low D'1711'
	retlw low D'1696'
	retlw low D'1681'
	retlw low D'1666'
	retlw low D'1651'
	retlw low D'1637'
	retlw low D'1623'
	retlw low D'1609'
	retlw low D'1596'
	retlw low D'1582'
	retlw low D'1569'
	retlw low D'1557'
	retlw low D'1544'
	retlw low D'1531'
	retlw low D'1519'
	retlw low D'1507'
	retlw low D'1495'
	retlw low D'1483'
	retlw low D'1472'
	retlw low D'1461'
	retlw low D'1449'
	retlw low D'1438'
	retlw low D'1428'
	retlw low D'1417'
	retlw low D'1406'
	retlw low D'1396'
	retlw low D'1386'
	retlw low D'1376'
	retlw low D'1366'
	retlw low D'1356'
	retlw low D'1346'
	retlw low D'1337'
	retlw low D'1328'
	retlw low D'1318'
	retlw low D'1309'
	retlw low D'1300'
	retlw low D'1291'
	retlw low D'1283'
	retlw low D'1274'
	retlw low D'1266'
	retlw low D'1257'
	retlw low D'1249'
	retlw low D'1241'
	retlw low D'1233'
	retlw low D'1225'
	retlw low D'1217'
	retlw low D'1209'
	retlw low D'1201'
	retlw low D'1194'
	retlw low D'1186'
	retlw low D'1179'
	retlw low D'1172'
	retlw low D'1165'
	retlw low D'1157'
	retlw low D'1150'
	retlw low D'1143'
	retlw low D'1137'
	retlw low D'1130'
	retlw low D'1123'
	retlw low D'1117'
	retlw low D'1110'
	retlw low D'1104'
	retlw low D'1097'
	retlw low D'1091'
	retlw low D'1085'
	retlw low D'1078'
	retlw low D'1072'
	retlw low D'1066'
	retlw low D'1060'
	retlw low D'1054'
	retlw low D'1049'
	retlw low D'1043'
	retlw low D'1037'
	retlw low D'1031'
	retlw low D'1026'
	retlw low D'1020'
	retlw low D'1015'
	retlw low D'1009'
	retlw low D'1004'
	retlw low D'999'
	retlw low D'994'
	retlw low D'988'
	retlw low D'983'
	retlw low D'978'
	retlw low D'973'
	retlw low D'968'
	retlw low D'963'
	retlw low D'958'
	retlw low D'954'
	retlw low D'949'
	retlw low D'944'
	retlw low D'939'
	retlw low D'935'
	retlw low D'930'
	retlw low D'926'
	retlw low D'921'
	retlw low D'917'
	retlw low D'912'
	retlw low D'908'
	retlw low D'904'
	retlw low D'899'
	retlw low D'895'
	retlw low D'891'
	retlw low D'887'
	retlw low D'883'
	retlw low D'878'
	retlw low D'874'
	retlw low D'870'
	retlw low D'866'
	retlw low D'862'
	retlw low D'859'
	retlw low D'855'
	retlw low D'851'
	retlw low D'847'
	retlw low D'843'
	retlw low D'840'
	retlw low D'836'
	retlw low D'832'
	retlw low D'829'
	retlw low D'825'
	retlw low D'821'
	retlw low D'818'
	retlw low D'814'
	retlw low D'811'
	retlw low D'807'
	retlw low D'804'
	retlw low D'801'
	retlw low D'797'
	retlw low D'794'
	retlw low D'791'
	retlw low D'787'
	retlw low D'784'
	retlw low D'781'

